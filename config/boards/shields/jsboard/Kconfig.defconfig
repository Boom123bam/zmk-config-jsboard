## config/boards/shields/jsboard/Kconfig.defconfig
```kconfig
# Copyright (c) 2023 The ZMK Contributors
# SPDX-License-Identifier: MIT

if SHIELD_JSBOARD

config ZMK_KEYBOARD_NAME
    default "JSBOARD"

endif
```
