## config/boards/shields/jsboard/Kconfig.shield
```kconfig
# Copyright (c) 2023 The ZMK Contributors
# SPDX-License-Identifier: MIT

config SHIELD_JSBOARD
    def_bool $(shields_list_contains,jsboard)

right_encoder: encoder_right {
        compatible = "alps,ec11";
        a-gpios = <&gpio0 31 GPIO_ACTIVE_HIGH>;
        b-gpios = <&gpio1 1 GPIO_ACTIVE_HIGH>;
        steps = <80>;
        status = "disabled";
    };


sensors: sensors {
    compatible = "zmk,keymap-sensors";
    sensors = <&right_encoder>;
    triggers-per-rotation = <20>;
};

&left_encoder {
    status = "okay";
};
```
